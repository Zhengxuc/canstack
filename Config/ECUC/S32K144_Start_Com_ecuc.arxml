AUTOSAR XML (schema 4-2-1)
package /ActiveEcuC
  module config Com: implementation-config-variant=VARIANT-PRE-COMPILE, module-description=Com_Impl
    ComGeneration:
      ComOutOfBoundsWriteProtectionStrategy = NONE
      ComOutOfBoundsWriteSanitizer = false
      ComOutOfBoundsReadSanitizer = false
      ComReduceConstantData2Define = false
      ComBoolDataInArrayOfStructStrategy = BOOLEAN
      ComDeduplicateIndirectedData = true
      ComDataDeduplicationStrategy = WITH_CAST
      ComReduceBoolDataByNegationThreshold = 2
      ComReduceBoolDataByNumericalComparisonThreshold = 2
      ComReduceBoolDataByNumericalRelationThreshold = 2
      ComReduceBoolDataByNumericalOperandStrategy = WITH_ANY_VALUE
      ComReduceNumericalDataByOffsetThreshold = 2
      ComReduceNumericalDataByArraySubtractionThreshold = 2
      ComReduceDataByStreaming = false
      ComShortSymbols = false
      ComInterfacesForDeactivatedData = false
      ComReferringKeysInComments = false
    ComOptimization:
      ComTxCyclicProcessingISRLockThreshold = 1
      ComTxDeadlineMonitoringISRLockThreshold = 1
      ComTxProcessingISRLockThreshold = 1
      ComRxDeadlineMonitoringISRLockThreshold = 1
      ComRxDeferredProcessingISRLockThreshold = 1
      ComGatewayProcessingISRLockThreshold = 1
      ComGatewayDescriptionProcessingISRLockThreshold = 1
      ComIPduGroupISRLockThreshold = 1
    ComConfig: ComConfigurationId=0, ComRxDeferredNotificationCacheSize=0, ComRxImmediateNotificationCacheSize=0
      MyECU_oCAN00_Rx_4cbf71f7 (ComIPduGroup): ComIPduGroupHandleId=0
      sig_State_RearLeftDoor_omsg_Receive_oCAN00_84ad4140_Rx (ComSignal):
        ComBitPosition = 0
        ComBitSize = 1
        ComSignalEndianness = LITTLE_ENDIAN
        ComSignalInitValue = 0
        ComSignalType = BOOLEAN
        ComTimeout = 0
        ComSignalAccess = ACCESS_UNCLEAR
        ComHandleId = 7
        ComSystemTemplateSystemSignalRef = sig_State_RearLeftDoor
      sig_LampCnt_omsg_MyECU_Lamp_oCAN00_f37e68ea_Tx (ComSignal):
        ComBitPosition = 7
        ComBitSize = 8
        ComSignalEndianness = BIG_ENDIAN
        ComSignalInitValue = 0
        ComSignalType = UINT8
        ComTransferProperty = PENDING
        ComSignalAccess = ACCESS_UNCLEAR
        ComHandleId = 3
        ComSystemTemplateSystemSignalRef = sig_LampCnt
      ComTimeBase: ComRxTimeBase=0.01, ComTxTimeBase=0.01, ComGwTimeBase=0.01
      msg_Transmit_oCAN00_0723e95e_Tx (ComIPdu):
        ComIPduDirection = SEND
        ComIPduType = NORMAL
        ComIPduHandleId = 2
        ComIPduSignalProcessing = DEFERRED
        ComIPduCancellationSupport = false
        ComIPduGroupRef = MyECU_oCAN00_Tx_1ae5d671
        ComIPduSignalRef = sig_RearInteriorLight_omsg_Transmit_oCAN00_49a633c1_Tx
        ComPduIdRef = msg_Transmit_oCAN00_0723e95e_Tx
        ComTxIPdu: ComMinimumDelayTime=0, ComTxIPduUnusedAreasDefault=0
          ComTxModeTrue
            ComTxMode: ComTxModeMode=PERIODIC, ComTxModeTimeOffset=0, ComTxModeTimePeriod=0.1
          ComTxModeFalse
            ComTxMode: ComTxModeMode=PERIODIC, ComTxModeTimeOffset=0, ComTxModeTimePeriod=0.1
      sig_State_RearInteriorLight_omsg_Receive_oCAN00_63323183_Rx (ComSignal):
        ComBitPosition = 2
        ComBitSize = 1
        ComSignalEndianness = LITTLE_ENDIAN
        ComSignalInitValue = 0
        ComSignalType = BOOLEAN
        ComTimeout = 0
        ComSignalAccess = ACCESS_UNCLEAR
        ComHandleId = 6
        ComSystemTemplateSystemSignalRef = sig_State_RearInteriorLight
      sig_State_RearRightDoor_omsg_Receive_oCAN00_a8945098_Rx (ComSignal):
        ComBitPosition = 1
        ComBitSize = 1
        ComSignalEndianness = LITTLE_ENDIAN
        ComSignalInitValue = 0
        ComSignalType = BOOLEAN
        ComTimeout = 0
        ComSignalAccess = ACCESS_UNCLEAR
        ComHandleId = 8
        ComSystemTemplateSystemSignalRef = sig_State_RearRightDoor
      msg_Receive_oCAN00_2b456e3f_Rx (ComIPdu):
        ComIPduDirection = RECEIVE
        ComIPduType = NORMAL
        ComIPduHandleId = 1
        ComIPduSignalProcessing = DEFERRED
        ComIPduCancellationSupport = false
        ComIPduGroupRef = MyECU_oCAN00_Rx_4cbf71f7
        ComIPduSignalRef = sig_State_RearInteriorLight_omsg_Receive_oCAN00_63323183_Rx
        ComIPduSignalRef = sig_State_RearLeftDoor_omsg_Receive_oCAN00_84ad4140_Rx
        ComIPduSignalRef = sig_State_RearRightDoor_omsg_Receive_oCAN00_a8945098_Rx
        ComPduIdRef = msg_Receive_oCAN00_2b456e3f_Rx
      MyECU_oCAN00_Tx_1ae5d671 (ComIPduGroup): ComIPduGroupHandleId=1
      msg_MyECU_Lamp_oCAN00_818e1651_Tx (ComIPdu):
        ComIPduDirection = SEND
        ComIPduType = NORMAL
        ComIPduHandleId = 0
        ComIPduSignalProcessing = DEFERRED
        ComIPduCancellationSupport = false
        ComIPduGroupRef = MyECU_oCAN00_Tx_1ae5d671
        ComIPduSignalRef = sig_LampCnt_omsg_MyECU_Lamp_oCAN00_f37e68ea_Tx
        ComPduIdRef = msg_MyECU_Lamp_oCAN00_818e1651_Tx
        ComTxIPdu: ComMinimumDelayTime=0, ComTxIPduUnusedAreasDefault=0
          ComTxModeTrue
            ComTxMode: ComTxModeMode=PERIODIC, ComTxModeTimeOffset=0, ComTxModeTimePeriod=0.1
          ComTxModeFalse
            ComTxMode: ComTxModeMode=PERIODIC, ComTxModeTimeOffset=0, ComTxModeTimePeriod=0.1
      3 x ComSignal, all with ComSignalEndianness=LITTLE_ENDIAN, ComSignalInitValue=0, ComSignalAccess=ACCESS_UNCLEAR:
        sig_RearInteriorLight_omsg_Transmit_oCAN00_49a633c1_Tx: ComBitPosition=0, ComBitSize=1, ComSignalType=BOOLEAN, ComTransferProperty=PENDING, ComHandleId=4, ComSystemTemplateSystemSignalRef=sig_RearInteriorLight
        PassWinSwS_omsg_MyRecive_oCAN00_8f0d1188_Rx: ComBitPosition=16, ComBitSize=8, ComSignalType=UINT8, ComTimeout=0, ComHandleId=3, ComSystemTemplateSystemSignalRef=PassWinSwS
        PEPS_Command_omsg_MyRecive_oCAN00_f2e00ab9_Rx: ComBitPosition=24, ComBitSize=8, ComSignalType=UINT8, ComTimeout=0, ComHandleId=2, ComSystemTemplateSystemSignalRef=PEPS_Command
      msg_MyTransmit_oCAN00_7a8a0a44_Tx (ComIPdu):
        ComIPduDirection = SEND
        ComIPduType = NORMAL
        ComIPduHandleId = 1
        ComIPduSignalProcessing = DEFERRED
        ComIPduCancellationSupport = false
        ComIPduGroupRef = MyECU_oCAN00_Tx_1ae5d671
        ComIPduSignalRef = BD1_St_PDWinMove_omsg_MyTransmit_oCAN00_227f0fc3_Tx
        ComIPduSignalRef = PassWin_Down_omsg_MyTransmit_oCAN00_4541bacd_Tx
        ComIPduSignalRef = PassWin_Up_omsg_MyTransmit_oCAN00_1b0e9f4a_Tx
        ComPduIdRef = msg_MyTransmit_oCAN00_7a8a0a44_Tx
        ComTxIPdu: ComMinimumDelayTime=0, ComTxIPduUnusedAreasDefault=0
          ComTxModeTrue
            ComTxMode: ComTxModeMode=MIXED, ComTxModeNumberOfRepetitions=3, ComTxModeRepetitionPeriod=0.02, ComTxModeTimePeriod=0.1, ComTxModeTimeOffset=0
          ComTxModeFalse
            ComTxMode: ComTxModeMode=NONE
      PassWin_Up_omsg_MyTransmit_oCAN00_1b0e9f4a_Tx (ComSignal):
        ComBitPosition = 16
        ComBitSize = 8
        ComSignalEndianness = LITTLE_ENDIAN
        ComSignalInitValue = 0
        ComSignalType = UINT8
        ComTransferProperty = PENDING
        ComSignalAccess = ACCESS_UNCLEAR
        ComHandleId = 2
        ComSystemTemplateSystemSignalRef = PassWin_Up
      msg_MyRecive_oCAN00_d55fa7d8_Rx (ComIPdu):
        ComIPduDirection = RECEIVE
        ComIPduType = NORMAL
        ComIPduHandleId = 0
        ComIPduSignalProcessing = DEFERRED
        ComIPduCancellationSupport = false
        ComIPduGroupRef = MyECU_oCAN00_Rx_4cbf71f7
        ComIPduSignalRef = Cgf_WinAutoMaxRunTimPrm_omsg_MyRecive_oCAN00_d44c11b7_Rx
        ComIPduSignalRef = Cgf_WinEnDelayTimPrm_omsg_MyRecive_oCAN00_02c07602_Rx
        ComIPduSignalRef = PEPS_Command_omsg_MyRecive_oCAN00_f2e00ab9_Rx
        ComIPduSignalRef = PassWinSwS_omsg_MyRecive_oCAN00_8f0d1188_Rx
        ComIPduSignalRef = RearRightDoorJar_omsg_MyRecive_oCAN00_c3180866_Rx
        ComIPduSignalRef = Sig_KL_15_IG_omsg_MyRecive_oCAN00_cbc434f2_Rx
        ComPduIdRef = msg_MyRecive_oCAN00_d55fa7d8_Rx
      6 x ComSignal, all with ComBitSize=8, ComSignalEndianness=LITTLE_ENDIAN, ComSignalInitValue=0, ComSignalType=UINT8, ComSignalAccess=ACCESS_UNCLEAR:
        Sig_KL_15_IG_omsg_MyRecive_oCAN00_cbc434f2_Rx: ComBitPosition=40, ComTimeout=0, ComHandleId=5, ComSystemTemplateSystemSignalRef=Sig_KL_15_IG
        Cgf_WinAutoMaxRunTimPrm_omsg_MyRecive_oCAN00_d44c11b7_Rx: ComBitPosition=8, ComTimeout=0, ComHandleId=0, ComSystemTemplateSystemSignalRef=Cgf_WinAutoMaxRunTimPrm
        BD1_St_PDWinMove_omsg_MyTransmit_oCAN00_227f0fc3_Tx: ComBitPosition=0, ComTransferProperty=PENDING, ComHandleId=0, ComSystemTemplateSystemSignalRef=BD1_St_PDWinMove
        RearRightDoorJar_omsg_MyRecive_oCAN00_c3180866_Rx: ComBitPosition=32, ComTimeout=0, ComHandleId=4, ComSystemTemplateSystemSignalRef=RearRightDoorJar
        PassWin_Down_omsg_MyTransmit_oCAN00_4541bacd_Tx: ComBitPosition=8, ComTransferProperty=PENDING, ComHandleId=1, ComSystemTemplateSystemSignalRef=PassWin_Down
        Cgf_WinEnDelayTimPrm_omsg_MyRecive_oCAN00_02c07602_Rx: ComBitPosition=48, ComTimeout=0, ComHandleId=1, ComSystemTemplateSystemSignalRef=Cgf_WinEnDelayTimPrm
    ComGeneral:
      ComConfigurationUseDet = true
      ComEnableSignalGroupArrayApi = false
      ComRetryFailedTransmitRequests = false
      ComSupportedIPduGroups = 2
      ComVersionInfoApi = false
      ComAdvancedIPduCallouts = true
      ComOptimizedIPduGroupHandling = false
      ComMetaDataSupport = false
      ComReceiveSignalMacroAPI = false
      ComDeferredEventCacheSupport = false
      ComMainfunctionTimingDomainSupport = false
      ComDescriptionRoutingCodeGeneration = false
      ComSafeBswChecks = false
