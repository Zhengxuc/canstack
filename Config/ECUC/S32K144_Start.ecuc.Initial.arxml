AUTOSAR XML (schema 4-2-1)
package /InitialEcuC
  ecuc value collection InitialEcuC: ecuc-values=[Can, CanIf, CanNm, CanSM, CanTp, Com, ComM, Dcm, Dem, EcuC, EcuM, Nm, PduR]
  module config Can
    CanConfigSet
      CT_CAN00_9df8a959 (CanController):
        CanControllerActivation = true
        CanControllerDefaultBaudrate = CanControllerBaudrateConfig
        CanControllerSystemRef = CT_CAN00
        CanWakeupSourceRef = EcuMCommonConfiguration/CN_CAN00_5e566ad9
        CanControllerBaudrateConfig
      CN_CAN00_5e566ad9_Tx (CanHardwareObject): CanHandleType=BASIC, CanIdValue=0, CanObjectType=TRANSMIT, CanControllerRef=CanConfigSet/CT_CAN00_9df8a959
      CN_CAN00_770af0b0_Rx (CanHardwareObject): CanHandleType=BASIC, CanIdType=STANDARD, CanIdValue=0, CanObjectType=RECEIVE, CanControllerRef=CanConfigSet/CT_CAN00_9df8a959
    CanGeneral: CanIndex=0
  module config CanIf
    CanIfCtrlDrvCfg_7d254554 (CanIfCtrlDrvCfg): CanIfCtrlDrvInitHohConfigRef=CanIfInitHohCfg, CanIfCtrlDrvNameRef=CanGeneral
      CT_CAN00_9df8a959 (CanIfCtrlCfg): CanIfCtrlCanCtrlRef=CanConfigSet/CT_CAN00_9df8a959
    CanIfInitCfg
      CHNL_0fb271d2 (CanIfBufferCfg): CanIfBufferSize=0, CanIfBufferHthRef=CanIfInitHohCfg/CN_CAN00_5e566ad9_Tx
      CanIfInitHohCfg: CanIfInitRefCfgSet=CanConfigSet
        CN_CAN00_770af0b0_Rx (CanIfHrhCfg): CanIfHrhCanCtrlIdRef=CanIfCtrlDrvCfg_7d254554/CT_CAN00_9df8a959, CanIfHrhIdSymRef=CanConfigSet/CN_CAN00_770af0b0_Rx
        CN_CAN00_5e566ad9_Tx (CanIfHthCfg): CanIfHthCanCtrlIdRef=CanIfCtrlDrvCfg_7d254554/CT_CAN00_9df8a959, CanIfHthIdSymRef=CanConfigSet/CN_CAN00_5e566ad9_Tx
      5 x CanIfRxPduCfg, all with CanIfRxPduCanIdType=STANDARD_CAN, CanIfRxPduHrhIdRef=CanIfInitHohCfg/CN_CAN00_770af0b0_Rx:
        MyECU_f835e395_Rx: CanIfRxPduDlc=8, CanIfRxPduUserRxIndicationName=CanNm_RxIndication, CanIfRxPduUserRxIndicationUL=CAN_NM, CanIfRxPduRef=MyECU_df2f1767_Rx
          CHNL_39b6d69b (CanIfRxPduCanIdRange): CanIfRxPduCanIdRangeLowerCanId=1024, CanIfRxPduCanIdRangeUpperCanId=1087
        msg_MyRecive_oCAN00_898c4aeb_Rx: CanIfRxPduCanId=1793, CanIfRxPduDlc=7, CanIfRxPduUserRxIndicationName=PduR_CanIfRxIndication, CanIfRxPduUserRxIndicationUL=PDUR, CanIfRxPduRef=EcucPduCollection/msg_MyRecive_oCAN00_e0a7405f_Rx
        msg_Receive_oCAN00_76f25845_Rx: CanIfRxPduCanId=528, CanIfRxPduDlc=1, CanIfRxPduUserRxIndicationName=PduR_CanIfRxIndication, CanIfRxPduUserRxIndicationUL=PDUR, CanIfRxPduRef=EcucPduCollection/msg_Receive_oCAN00_3867e0b8_Rx
        msg_diag_RequestGlobal_Tp_oCAN00_5c56b065_Rx: CanIfRxPduCanId=1556, CanIfRxPduDlc=8, CanIfRxPduUserRxIndicationName=CanTp_RxIndication, CanIfRxPduUserRxIndicationType=PDUID_PDUINFOPTR, CanIfRxPduUserRxIndicationUL=CAN_TP, CanIfRxPduRef=msg_diag_RequestGlobal_Tp_oCAN00_7b1e9193_Rx
        msg_diag_Request_MyECU_Tp_oCAN00_2c5ccddc_Rx: CanIfRxPduCanId=1552, CanIfRxPduDlc=8, CanIfRxPduUserRxIndicationName=CanTp_RxIndication, CanIfRxPduUserRxIndicationType=PDUID_PDUINFOPTR, CanIfRxPduUserRxIndicationUL=CAN_TP, CanIfRxPduRef=msg_diag_Request_MyECU_Tp_oCAN00_ecbacca2_Rx
      5 x CanIfTxPduCfg, all with CanIfTxPduCanIdType=STANDARD_CAN, CanIfTxPduBufferRef=CanIfInitCfg/CHNL_0fb271d2:
        msg_MyECU_Lamp_oCAN00_41befc25_Tx: CanIfTxPduCanId=1297, CanIfTxPduDlc=8, CanIfTxPduUserTxConfirmationName=PduR_CanIfTxConfirmation, CanIfTxPduUserTxConfirmationUL=PDUR, CanIfTxPduRef=EcucPduCollection/msg_MyECU_Lamp_oCAN00_26f3473b_Tx
        msg_MyTransmit_oCAN00_d210c76d_Tx: CanIfTxPduCanId=1794, CanIfTxPduDlc=8, CanIfTxPduUserTxConfirmationName=PduR_CanIfTxConfirmation, CanIfTxPduUserTxConfirmationUL=PDUR, CanIfTxPduRef=EcucPduCollection/msg_MyTransmit_oCAN00_e8f7eb32_Tx
        msg_Transmit_oCAN00_29db34a4_Tx: CanIfTxPduCanId=512, CanIfTxPduDlc=1, CanIfTxPduUserTxConfirmationName=PduR_CanIfTxConfirmation, CanIfTxPduUserTxConfirmationUL=PDUR, CanIfTxPduRef=EcucPduCollection/msg_Transmit_oCAN00_9631a86b_Tx
        msg_diag_Response_MyECU_Tp_oCAN00_59e48f7a_Tx: CanIfTxPduCanId=1554, CanIfTxPduDlc=8, CanIfTxPduUserTxConfirmationName=CanTp_TxConfirmation, CanIfTxPduUserTxConfirmationUL=CAN_TP, CanIfTxPduRef=msg_diag_Response_MyECU_Tp_oCAN00_0ed9d144_Tx
        msg_nm_MyECU_oCAN00_dfbc2140_Tx: CanIfTxPduCanId=1024, CanIfTxPduDlc=8, CanIfTxPduUserTxConfirmationName=CanNm_TxConfirmation, CanIfTxPduUserTxConfirmationUL=CAN_NM, CanIfTxPduRef=EcucPduCollection/msg_nm_MyECU_oCAN00_077ec9e6_Tx
    CanIfPrivateCfg: CanIfPrivateSoftwareFilterType=LINEAR
    CanIfPublicCfg: CanIfPublicPnSupport=false
  module config CanNm
    CanNmGlobalConfig: CanNmPnEiraCalcEnabled=false, CanNmUserDataEnabled=true
      CAN00_CAN_5faa4e95 (CanNmChannelConfig):
        CanNmMsgCycleTime = 0.1
        CanNmMsgReducedTime = 0.05
        CanNmNodeId = 0
        CanNmRepeatMessageTime = 0.4
        CanNmTimeoutTime = 1
        CanNmUserDataLength = 6
        CanNmWaitBusSleepTime = 0.75
        CanNmComMNetworkHandleRef = ComMConfigSet/CN_CAN00_5e566ad9
        CAN00_CAN_5faa4e95_Rx (CanNmRxPdu): CanNmRxPduRef=MyECU_df2f1767_Rx
        msg_nm_MyECU_oCAN00_077ec9e6_Tx (CanNmTxPdu): CanNmTxPduRef=EcucPduCollection/msg_nm_MyECU_oCAN00_077ec9e6_Tx
  module config CanSM
    CanSMConfiguration
      CHNL_0fb271d2 (CanSMManagerNetwork): CanSMComMNetworkHandleRef=ComMConfigSet/CN_CAN00_5e566ad9
        CT_CAN00_f3aba03e (CanSMController): CanSMControllerId=CanIfCtrlDrvCfg_7d254554/CT_CAN00_9df8a959
  module config CanTp
    CanTpConfig: CanTpMainFunctionPeriod=0.005
      TPCH_3983176e (CanTpChannel): CanTpChannelMode=CANTP_MODE_FULL_DUPLEX
        CanTpRxNSdu_678e3b4e (CanTpRxNSdu):
          CanTpRxAddressingFormat = CANTP_STANDARD
          CanTpRxDl = 8
          CanTpRxTaType = CANTP_FUNCTIONAL
          CanTpRxNSduRef = EcucPduCollection/msg_diag_RequestGlobal_oCAN00_38f4a687_Rx
          CanTpRxNPdu_55155daa (CanTpRxNPdu): CanTpRxNPduRef=msg_diag_RequestGlobal_Tp_oCAN00_7b1e9193_Rx
      TPCH_e391c48f (CanTpChannel): CanTpChannelMode=CANTP_MODE_FULL_DUPLEX
        CanTpRxNSdu_85e31bc0 (CanTpRxNSdu):
          CanTpRxAddressingFormat = CANTP_STANDARD
          CanTpRxDl = 8
          CanTpRxTaType = CANTP_PHYSICAL
          CanTpRxNSduRef = EcucPduCollection/msg_diag_Request_MyECU_oCAN00_a823f7ba_Rx
          CanTpRxNPdu_7fe257d9 (CanTpRxNPdu): CanTpRxNPduRef=msg_diag_Request_MyECU_Tp_oCAN00_ecbacca2_Rx
          CanTpTxFcNPdu_7fe257d9 (CanTpTxFcNPdu): CanTpTxFcNPduRef=msg_diag_Response_MyECU_Tp_oCAN00_0ed9d144_Tx
        CanTpTxNSdu_85e31bc0 (CanTpTxNSdu):
          CanTpTxAddressingFormat = CANTP_STANDARD
          CanTpTxDl = 8
          CanTpTxTaType = CANTP_PHYSICAL
          CanTpTxNSduRef = EcucPduCollection/msg_diag_Response_MyECU_oCAN00_45311294_Tx
          CanTpRxFcNPdu_5d18832b (CanTpRxFcNPdu): CanTpRxFcNPduRef=msg_diag_Request_MyECU_Tp_oCAN00_ecbacca2_Rx
          CanTpTxNPdu_5d18832b (CanTpTxNPdu): CanTpTxNPduRef=msg_diag_Response_MyECU_Tp_oCAN00_0ed9d144_Tx
  module config Com
    ComConfig
      5 x ComIPdu, all with ComIPduType=NORMAL:
        msg_MyECU_Lamp_oCAN00_818e1651_Tx: ComIPduDirection=SEND, ComIPduGroupRef=MyECU_oCAN00_Tx_1ae5d671, ComIPduSignalRef=sig_LampCnt_omsg_MyECU_Lamp_oCAN00_f37e68ea_Tx, ComPduIdRef=EcucPduCollection/msg_MyECU_Lamp_oCAN00_818e1651_Tx
          ComTxIPdu: ComMinimumDelayTime=0, ComTxIPduUnusedAreasDefault=0
            ComTxModeFalse
              ComTxMode: ComTxModeMode=PERIODIC, ComTxModeTimeOffset=0, ComTxModeTimePeriod=0.1
            ComTxModeTrue
              ComTxMode: ComTxModeMode=PERIODIC, ComTxModeTimeOffset=0, ComTxModeTimePeriod=0.1
        msg_MyRecive_oCAN00_d55fa7d8_Rx: ComIPduDirection=RECEIVE, ComIPduGroupRef=MyECU_oCAN00_Rx_4cbf71f7, ComIPduSignalRef=Cgf_WinAutoMaxRunTimPrm_omsg_MyRecive_oCAN00_d44c11b7_Rx, ComIPduSignalRef=Cgf_WinEnDelayTimPrm_omsg_MyRecive_oCAN00_02c07602_Rx, ComIPduSignalRef=PEPS_Command_omsg_MyRecive_oCAN00_f2e00ab9_Rx, ComIPduSignalRef=PassWinSwS_omsg_MyRecive_oCAN00_8f0d1188_Rx, ComIPduSignalRef=RearRightDoorJar_omsg_MyRecive_oCAN00_c3180866_Rx, ComIPduSignalRef=Sig_KL_15_IG_omsg_MyRecive_oCAN00_cbc434f2_Rx, ComPduIdRef=EcucPduCollection/msg_MyRecive_oCAN00_d55fa7d8_Rx
        msg_MyTransmit_oCAN00_7a8a0a44_Tx: ComIPduDirection=SEND, ComIPduGroupRef=MyECU_oCAN00_Tx_1ae5d671, ComIPduSignalRef=BD1_St_PDWinMove_omsg_MyTransmit_oCAN00_227f0fc3_Tx, ComIPduSignalRef=PassWin_Down_omsg_MyTransmit_oCAN00_4541bacd_Tx, ComIPduSignalRef=PassWin_Up_omsg_MyTransmit_oCAN00_1b0e9f4a_Tx, ComPduIdRef=EcucPduCollection/msg_MyTransmit_oCAN00_7a8a0a44_Tx
          ComTxIPdu: ComMinimumDelayTime=0, ComTxIPduUnusedAreasDefault=0
        msg_Receive_oCAN00_2b456e3f_Rx: ComIPduDirection=RECEIVE, ComIPduGroupRef=MyECU_oCAN00_Rx_4cbf71f7, ComIPduSignalRef=sig_State_RearInteriorLight_omsg_Receive_oCAN00_63323183_Rx, ComIPduSignalRef=sig_State_RearLeftDoor_omsg_Receive_oCAN00_84ad4140_Rx, ComIPduSignalRef=sig_State_RearRightDoor_omsg_Receive_oCAN00_a8945098_Rx, ComPduIdRef=EcucPduCollection/msg_Receive_oCAN00_2b456e3f_Rx
        msg_Transmit_oCAN00_0723e95e_Tx: ComIPduDirection=SEND, ComIPduGroupRef=MyECU_oCAN00_Tx_1ae5d671, ComIPduSignalRef=sig_RearInteriorLight_omsg_Transmit_oCAN00_49a633c1_Tx, ComPduIdRef=EcucPduCollection/msg_Transmit_oCAN00_0723e95e_Tx
          ComTxIPdu: ComMinimumDelayTime=0, ComTxIPduUnusedAreasDefault=0
            ComTxModeFalse
              ComTxMode: ComTxModeMode=PERIODIC, ComTxModeTimeOffset=0, ComTxModeTimePeriod=0.1
            ComTxModeTrue
              ComTxMode: ComTxModeMode=PERIODIC, ComTxModeTimeOffset=0, ComTxModeTimePeriod=0.1
      MyECU_oCAN00_Rx_4cbf71f7 (ComIPduGroup)
      MyECU_oCAN00_Tx_1ae5d671 (ComIPduGroup)
      14 x ComSignal, all with ComSignalInitValue=0:
        BD1_St_PDWinMove_omsg_MyTransmit_oCAN00_227f0fc3_Tx: ComBitPosition=0, ComBitSize=8, ComSignalEndianness=LITTLE_ENDIAN, ComSignalType=UINT8, ComTransferProperty=PENDING, ComSystemTemplateSystemSignalRef=BD1_St_PDWinMove
        Cgf_WinAutoMaxRunTimPrm_omsg_MyRecive_oCAN00_d44c11b7_Rx: ComBitPosition=8, ComBitSize=8, ComSignalEndianness=LITTLE_ENDIAN, ComSignalType=UINT8, ComTimeout=0, ComSystemTemplateSystemSignalRef=Cgf_WinAutoMaxRunTimPrm
        Cgf_WinEnDelayTimPrm_omsg_MyRecive_oCAN00_02c07602_Rx: ComBitPosition=48, ComBitSize=8, ComSignalEndianness=LITTLE_ENDIAN, ComSignalType=UINT8, ComTimeout=0, ComSystemTemplateSystemSignalRef=Cgf_WinEnDelayTimPrm
        PEPS_Command_omsg_MyRecive_oCAN00_f2e00ab9_Rx: ComBitPosition=24, ComBitSize=8, ComSignalEndianness=LITTLE_ENDIAN, ComSignalType=UINT8, ComTimeout=0, ComSystemTemplateSystemSignalRef=PEPS_Command
        PassWinSwS_omsg_MyRecive_oCAN00_8f0d1188_Rx: ComBitPosition=16, ComBitSize=8, ComSignalEndianness=LITTLE_ENDIAN, ComSignalType=UINT8, ComTimeout=0, ComSystemTemplateSystemSignalRef=PassWinSwS
        PassWin_Down_omsg_MyTransmit_oCAN00_4541bacd_Tx: ComBitPosition=8, ComBitSize=8, ComSignalEndianness=LITTLE_ENDIAN, ComSignalType=UINT8, ComTransferProperty=PENDING, ComSystemTemplateSystemSignalRef=PassWin_Down
        PassWin_Up_omsg_MyTransmit_oCAN00_1b0e9f4a_Tx: ComBitPosition=16, ComBitSize=8, ComSignalEndianness=LITTLE_ENDIAN, ComSignalType=UINT8, ComTransferProperty=PENDING, ComSystemTemplateSystemSignalRef=PassWin_Up
        RearRightDoorJar_omsg_MyRecive_oCAN00_c3180866_Rx: ComBitPosition=32, ComBitSize=8, ComSignalEndianness=LITTLE_ENDIAN, ComSignalType=UINT8, ComTimeout=0, ComSystemTemplateSystemSignalRef=RearRightDoorJar
        Sig_KL_15_IG_omsg_MyRecive_oCAN00_cbc434f2_Rx: ComBitPosition=40, ComBitSize=8, ComSignalEndianness=LITTLE_ENDIAN, ComSignalType=UINT8, ComTimeout=0, ComSystemTemplateSystemSignalRef=Sig_KL_15_IG
        sig_LampCnt_omsg_MyECU_Lamp_oCAN00_f37e68ea_Tx: ComBitPosition=7, ComBitSize=8, ComSignalEndianness=BIG_ENDIAN, ComSignalType=UINT8, ComTransferProperty=PENDING, ComSystemTemplateSystemSignalRef=sig_LampCnt
        sig_RearInteriorLight_omsg_Transmit_oCAN00_49a633c1_Tx: ComBitPosition=0, ComBitSize=1, ComSignalEndianness=LITTLE_ENDIAN, ComSignalType=BOOLEAN, ComTransferProperty=PENDING, ComSystemTemplateSystemSignalRef=sig_RearInteriorLight
        sig_State_RearInteriorLight_omsg_Receive_oCAN00_63323183_Rx: ComBitPosition=2, ComBitSize=1, ComSignalEndianness=LITTLE_ENDIAN, ComSignalType=BOOLEAN, ComTimeout=0, ComSystemTemplateSystemSignalRef=sig_State_RearInteriorLight
        sig_State_RearLeftDoor_omsg_Receive_oCAN00_84ad4140_Rx: ComBitPosition=0, ComBitSize=1, ComSignalEndianness=LITTLE_ENDIAN, ComSignalType=BOOLEAN, ComTimeout=0, ComSystemTemplateSystemSignalRef=sig_State_RearLeftDoor
        sig_State_RearRightDoor_omsg_Receive_oCAN00_a8945098_Rx: ComBitPosition=1, ComBitSize=1, ComSignalEndianness=LITTLE_ENDIAN, ComSignalType=BOOLEAN, ComTimeout=0, ComSystemTemplateSystemSignalRef=sig_State_RearRightDoor
    ComGeneral
  module config ComM
    ComMConfigSet: ComMPncEnabled=false
      CN_CAN00_5e566ad9 (ComMChannel): ComMBusType=COMM_BUS_TYPE_CAN, ComMChannelId=0
        ComMNetworkManagement: ComMNmVariant=FULL
        CN_CAN00_cd7594b0 (ComMUserPerChannel): ComMUserChannel=CN_CAN00_06ecbb07
      CN_CAN00_06ecbb07 (ComMUser): ComMUserIdentifier=0
    ComMGeneral: ComMPncIdCounting=COMM_PNC_ID_COUNT_FROM_NM_MESSAGE, ComMPncSupport=false
  module config Dcm
    DcmConfigSet  # Diagnostics Data Import
      DcmDsl
        DcmDslProtocol
          DcmDslProtocolRow_29812fbf (DcmDslProtocolRow)
            DcmDslConnection_b0ac4f47 (DcmDslConnection)
              DcmDslMainConnection
                msg_diag_RequestGlobal_oCAN00_25be229e_Rx_6a1ea0f3 (DcmDslProtocolRx):
                  DcmDslProtocolRxAddrType = DCM_FUNCTIONAL_TYPE
                  DcmDslProtocolRxPduId = 1
                  DcmDslProtocolRxComMChannelRef = ComMConfigSet/CN_CAN00_5e566ad9
                  DcmDslProtocolRxPduRef = msg_diag_RequestGlobal_oCAN00_25be229e_Rx
                msg_diag_Request_MyECU_oCAN00_956934ec_Rx_b73501b5 (DcmDslProtocolRx):
                  DcmDslProtocolRxAddrType = DCM_PHYSICAL_TYPE
                  DcmDslProtocolRxPduId = 2
                  DcmDslProtocolRxComMChannelRef = ComMConfigSet/CN_CAN00_5e566ad9
                  DcmDslProtocolRxPduRef = msg_diag_Request_MyECU_oCAN00_956934ec_Rx
                msg_diag_Response_MyECU_oCAN00_f4dcbbcd_Tx_c184e7e6 (DcmDslProtocolTx): DcmDslTxConfirmationPduId=0, DcmDslProtocolTxPduRef=EcucPduCollection/msg_diag_Response_MyECU_oCAN00_f4dcbbcd_Tx
      DcmDsp: DcmDspMaxDidToRead=5  # Diagnostics Data Import
        DcmDspSession  # Diagnostics Data Import
          3 x DcmDspSessionRow, all with DcmDspSessionP2ServerMax=0.05, DcmDspSessionP2StarServerMax=5:
            Extended: DcmDspSessionLevel=3, DcmDspSessionForBoot=DCM_NO_BOOT  # Diagnostics Data Import
            Programming: DcmDspSessionLevel=2  # Diagnostics Data Import
            Default: DcmDspSessionLevel=1, DcmDspSessionForBoot=DCM_NO_BOOT  # Diagnostics Data Import
        DcmDspSecurity  # Diagnostics Data Import
          Level_01 (DcmDspSecurityRow):  # Diagnostics Data Import
            DcmDspSecurityDelayTime = 10
            DcmDspSecurityDelayTimeOnBoot = 0
            DcmDspSecurityKeySize = 2
            DcmDspSecurityLevel = 1
            DcmDspSecurityNumAttDelay = 3
            DcmDspSecuritySeedSize = 2
        DcmDspControlDTCSetting: DcmSupportDTCSettingControlOptionRecord=true  # Diagnostics Data Import
        DidInfo_Diag_RWDI_LightOnOffCounter (DcmDspDidInfo)  # Diagnostics Data Import
          DcmDspDidAccess  # Diagnostics Data Import
            DcmDspDidWrite  # Diagnostics Data Import
            DcmDspDidRead  # Diagnostics Data Import
        Diag_RWDI_LightOnOffCounter (DcmDspDid): DcmDspDidIdentifier=4096, DcmDspDidInfoRef=DidInfo_Diag_RWDI_LightOnOffCounter  # Diagnostics Data Import
          LightOnOffCounter_Value (DcmDspDidSignal): DcmDspDidDataPos=0, DcmDspDidDataRef=Diag_RWDI_LightOnOffCounter_LightOnOffCounter_Value  # Diagnostics Data Import
        DataInfo_Diag_RWDI_LightOnOffCounter_LightOnOffCounter_Value (DcmDspDataInfo): DcmDspDataFixedLength=true  # Diagnostics Data Import
        Diag_RWDI_LightOnOffCounter_LightOnOffCounter_Value (DcmDspData): DcmDspDataSize=32, DcmDspDataType=UINT32, DcmDspDataInfoRef=DataInfo_Diag_RWDI_LightOnOffCounter_LightOnOffCounter_Value  # Diagnostics Data Import
      DcmDsd  # Diagnostics Data Import
        DcmDsdServiceTable  # Diagnostics Data Import
          9 x DcmDsdService:
            ControlDtcSetting: DcmDsdSidTabServiceId=133, DcmDsdSidTabSubfuncAvail=true  # Diagnostics Data Import
              Disable (DcmDsdSubService): DcmDsdSubServiceId=2  # Diagnostics Data Import
              Enable (DcmDsdSubService): DcmDsdSubServiceId=1  # Diagnostics Data Import
            TesterPresent: DcmDsdSidTabServiceId=62, DcmDsdSidTabSubfuncAvail=true  # Diagnostics Data Import
              TesterPresent (DcmDsdSubService): DcmDsdSubServiceId=0  # Diagnostics Data Import
            WriteDataById: DcmDsdSidTabServiceId=46, DcmDsdSidTabSubfuncAvail=false  # Diagnostics Data Import
            SecurityAccess: DcmDsdSidTabServiceId=39, DcmDsdSidTabSubfuncAvail=true, DcmDsdSidTabSessionLevelRef=DcmDspSession/Programming, DcmDsdSidTabSessionLevelRef=DcmDspSession/Extended  # Diagnostics Data Import
              Level1_1_Send (DcmDsdSubService): DcmDsdSubServiceId=2, DcmDsdSubServiceSessionLevelRef=DcmDspSession/Programming, DcmDsdSubServiceSessionLevelRef=DcmDspSession/Extended  # Diagnostics Data Import
              Seed_Level1_Request (DcmDsdSubService): DcmDsdSubServiceId=1, DcmDsdSubServiceSessionLevelRef=DcmDspSession/Programming, DcmDsdSubServiceSessionLevelRef=DcmDspSession/Extended  # Diagnostics Data Import
            ReadDataById: DcmDsdSidTabServiceId=34, DcmDsdSidTabSubfuncAvail=false  # Diagnostics Data Import
            ReadDtcInfo: DcmDsdSidTabServiceId=25, DcmDsdSidTabSubfuncAvail=true  # Diagnostics Data Import
              3 x DcmDsdSubService:
                RDTCEDRBDN: DcmDsdSubServiceId=6  # Diagnostics Data Import
                RNODTCBSM: DcmDsdSubServiceId=1  # Diagnostics Data Import
                RDTCBSM: DcmDsdSubServiceId=2  # Diagnostics Data Import
            ClearDiagInfo: DcmDsdSidTabServiceId=20, DcmDsdSidTabSubfuncAvail=false  # Diagnostics Data Import
            EcuReset: DcmDsdSidTabServiceId=17, DcmDsdSidTabSubfuncAvail=true  # Diagnostics Data Import
              Hard (DcmDsdSubService): DcmDsdSubServiceId=1  # Diagnostics Data Import
            DiagSessionControl: DcmDsdSidTabServiceId=16, DcmDsdSidTabSubfuncAvail=true  # Diagnostics Data Import
              3 x DcmDsdSubService:
                Extended: DcmDsdSubServiceId=3  # Diagnostics Data Import
                Programming: DcmDsdSubServiceId=2, DcmDsdSubServiceSessionLevelRef=DcmDspSession/Programming, DcmDsdSubServiceSessionLevelRef=DcmDspSession/Extended  # Diagnostics Data Import
                Default: DcmDsdSubServiceId=1  # Diagnostics Data Import
      DcmGeneral  # Diagnostics Data Import
  module config Dem
    DemGeneral:  # Diagnostics Data Import
      DemAgingCycleCounterProcessing = DEM_PROCESS_AGINGCTR_INTERN
      DemDebounceCounterBasedSupport = true
      DemDtcStatusAvailabilityMask = 121
      DemMaxNumberEventEntryMirror = 0
      DemPTOSupport = false
      DemTypeOfFreezeFrameRecordNumeration = DEM_FF_RECNUM_CALCULATED
      OdometerValue_OdometerValue (DemDataClass):  # Diagnostics Data Import
        DemDataElementDataSize = 4
        DemDataElementDataType = UINT32
        DemDataElementEndianness = LITTLE_ENDIAN
        DemDataElementUsePort = USE_DATA_CLIENT_SERVER_PORT
        DemDataElementStoreNonVolatile = true
      OccurrenceCounter_OccurenceCounter (DemDataClass):  # Diagnostics Data Import
        DemDataElementDataSize = 4
        DemDataElementDataType = UINT32
        DemDataElementEndianness = LITTLE_ENDIAN
        DemDataElementUsePort = USE_DATA_CLIENT_SERVER_PORT
        DemDataElementStoreNonVolatile = true
      PowerCycle (DemOperationCycle): DemOperationCycleType=DEM_OPCYC_POWER  # Diagnostics Data Import
      IgnitionCycle (DemOperationCycle): DemOperationCycleType=DEM_OPCYC_IGNITION  # Diagnostics Data Import
      OdometerValue (DemExtendedDataRecordClass): DemExtendedDataRecordNumber=2, DemDataClassRef=OdometerValue_OdometerValue  # Diagnostics Data Import
      OccurrenceCounter (DemExtendedDataRecordClass): DemExtendedDataRecordNumber=1, DemDataClassRef=OccurrenceCounter_OccurenceCounter  # Diagnostics Data Import
      ExtendedDataClass_4f5344cd (DemExtendedDataClass): DemExtendedDataRecordClassRef=OccurrenceCounter, DemExtendedDataRecordClassRef=OdometerValue  # Diagnostics Data Import
    DemConfigSet  # Diagnostics Data Import
      DTC_0x000002 (DemEventParameter): DemEventKind=DEM_EVENT_KIND_SWC, DemDTCClassRef=DTCClass_DTC_0x000002, DemExtendedDataClassRef=ExtendedDataClass_4f5344cd  # Diagnostics Data Import
        DemEventClass:  # Diagnostics Data Import
          DemAgingAllowed = false
          DemAgingCycleCounterThreshold = 1
          DemEventDestination = DEM_DTC_ORIGIN_PRIMARY_MEMORY
          DemEventPriority = 2
          DemAgingCycleRef = IgnitionCycle
          DemOperationCycleRef = IgnitionCycle
          DemDebounceAlgorithmClass  # Diagnostics Data Import
            DemDebounceCounterBased: DemDebounceCounterDecrementStepSize=1, DemDebounceCounterIncrementStepSize=1, DemDebounceCounterJumpDown=false, DemDebounceCounterJumpUp=true  # Diagnostics Data Import
      DTCClass_DTC_0x000002 (DemDTCClass): DemUdsDTC=2  # Diagnostics Data Import
  module config EcuC
    EcucPduCollection: PduIdTypeEnum=UINT8, PduLengthTypeEnum=UINT8
      21 x Pdu:
        MyECU_df2f1767_Rx: PduLength=8, SysTPduToFrameMappingRef=msg_nm_RearECU
        msg_MyECU_Lamp_oCAN00_26f3473b_Tx: PduLength=8, SysTPduToFrameMappingRef=msg_MyECU_Lamp
        msg_MyECU_Lamp_oCAN00_818e1651_Tx: PduLength=8
        msg_MyRecive_oCAN00_d55fa7d8_Rx: PduLength=7
        msg_MyRecive_oCAN00_e0a7405f_Rx: PduLength=7, SysTPduToFrameMappingRef=msg_MyRecive
        msg_MyTransmit_oCAN00_7a8a0a44_Tx: PduLength=8
        msg_MyTransmit_oCAN00_e8f7eb32_Tx: PduLength=8, SysTPduToFrameMappingRef=msg_MyTransmit
        msg_Receive_oCAN00_2b456e3f_Rx: PduLength=1
        msg_Receive_oCAN00_3867e0b8_Rx: PduLength=1, SysTPduToFrameMappingRef=msg_Receive
        msg_Transmit_oCAN00_0723e95e_Tx: PduLength=1
        msg_Transmit_oCAN00_9631a86b_Tx: PduLength=1, SysTPduToFrameMappingRef=msg_Transmit
        msg_diag_RequestGlobal_Tp_oCAN00_7b1e9193_Rx: PduLength=8, SysTPduToFrameMappingRef=msg_diag_RequestGlobal_Tp
        msg_diag_RequestGlobal_oCAN00_25be229e_Rx: PduLength=7
        msg_diag_RequestGlobal_oCAN00_38f4a687_Rx: PduLength=7
        msg_diag_Request_MyECU_Tp_oCAN00_ecbacca2_Rx: PduLength=8, SysTPduToFrameMappingRef=msg_diag_Request_MyECU_Tp
        msg_diag_Request_MyECU_oCAN00_956934ec_Rx: PduLength=8
        msg_diag_Request_MyECU_oCAN00_a823f7ba_Rx: PduLength=8
        msg_diag_Response_MyECU_Tp_oCAN00_0ed9d144_Tx: PduLength=8, SysTPduToFrameMappingRef=msg_diag_Response_MyECU_Tp
        msg_diag_Response_MyECU_oCAN00_45311294_Tx: PduLength=8
        msg_diag_Response_MyECU_oCAN00_f4dcbbcd_Tx: PduLength=8
        msg_nm_MyECU_oCAN00_077ec9e6_Tx: PduLength=8, SysTPduToFrameMappingRef=msg_nm_MyECU
  module config EcuM
    EcuMConfiguration
      EcuMCommonConfiguration
        EcuMDriverInitListOne
        EcuMDriverRestartList
        CN_CAN00_5e566ad9 (EcuMWakeupSource): EcuMWakeupSourceId=5, EcuMComMChannelRef=ComMConfigSet/CN_CAN00_5e566ad9
      EcuMFlexConfiguration: EcuMFlexModuleConfigurationRef=CanConfigSet
  module config Nm
    CN_CAN00_5e566ad9 (NmChannelConfig): NmComMChannelRef=ComMConfigSet/CN_CAN00_5e566ad9
      CAN00_CAN_5faa4e95 (NmBusType)
        NmStandardBusNmConfig: NmStandardBusType=NM_BUSNM_CANNM  # CAN00_CAN
    NmGlobalConfig
      NmGlobalFeatures: NmNodeIdEnabled=true, NmUserDataEnabled=true
      NmGlobalProperties
  module config PduR
    PduRGeneral
    PduRRoutingTables
      PduRRoutingTable
        8 x PduRRoutingPath:
          msg_MyECU_Lamp_oCAN00_818e1651_Tx
            msg_MyECU_Lamp_oCAN00_26f3473b_Tx (PduRDestPdu): PduRDestPduRef=EcucPduCollection/msg_MyECU_Lamp_oCAN00_26f3473b_Tx
            PduRSrcPdu_8e8b997f (PduRSrcPdu): PduRSrcPduRef=EcucPduCollection/msg_MyECU_Lamp_oCAN00_818e1651_Tx
          msg_MyRecive_oCAN00_e0a7405f_Rx
            msg_MyRecive_oCAN00_e0a7405f_Rx_17dd81b8_Rx (PduRDestPdu): PduRDestPduRef=EcucPduCollection/msg_MyRecive_oCAN00_d55fa7d8_Rx
            PduRSrcPdu_17dd81b8 (PduRSrcPdu): PduRSrcPduRef=EcucPduCollection/msg_MyRecive_oCAN00_e0a7405f_Rx
          msg_MyTransmit_oCAN00_7a8a0a44_Tx
            msg_MyTransmit_oCAN00_e8f7eb32_Tx (PduRDestPdu): PduRDestPduRef=EcucPduCollection/msg_MyTransmit_oCAN00_e8f7eb32_Tx
            PduRSrcPdu_b0703eaf (PduRSrcPdu): PduRSrcPduRef=EcucPduCollection/msg_MyTransmit_oCAN00_7a8a0a44_Tx
          msg_Receive_oCAN00_3867e0b8_Rx
            msg_Receive_oCAN00_3867e0b8_Rx_16740ed0_Rx (PduRDestPdu): PduRDestPduRef=EcucPduCollection/msg_Receive_oCAN00_2b456e3f_Rx
            PduRSrcPdu_16740ed0 (PduRSrcPdu): PduRSrcPduRef=EcucPduCollection/msg_Receive_oCAN00_3867e0b8_Rx
          msg_Transmit_oCAN00_0723e95e_Tx
            msg_Transmit_oCAN00_9631a86b_Tx (PduRDestPdu): PduRDestPduRef=EcucPduCollection/msg_Transmit_oCAN00_9631a86b_Tx
            PduRSrcPdu_087fd70d (PduRSrcPdu): PduRSrcPduRef=EcucPduCollection/msg_Transmit_oCAN00_0723e95e_Tx
          msg_diag_RequestGlobal_oCAN00_38f4a687_Rx
            msg_diag_RequestGlobal_oCAN00_38f4a687_Rx_fdd5755a_Rx (PduRDestPdu): PduRDestPduRef=msg_diag_RequestGlobal_oCAN00_25be229e_Rx
            PduRSrcPdu_fdd5755a (PduRSrcPdu): PduRSrcPduRef=EcucPduCollection/msg_diag_RequestGlobal_oCAN00_38f4a687_Rx
          msg_diag_Request_MyECU_oCAN00_a823f7ba_Rx
            msg_diag_Request_MyECU_oCAN00_a823f7ba_Rx_11d927ad_Rx (PduRDestPdu): PduRDestPduRef=msg_diag_Request_MyECU_oCAN00_956934ec_Rx
            PduRSrcPdu_11d927ad (PduRSrcPdu): PduRSrcPduRef=EcucPduCollection/msg_diag_Request_MyECU_oCAN00_a823f7ba_Rx
          msg_diag_Response_MyECU_oCAN00_f4dcbbcd_Tx
            msg_diag_Response_MyECU_oCAN00_45311294_Tx (PduRDestPdu): PduRDestPduRef=EcucPduCollection/msg_diag_Response_MyECU_oCAN00_45311294_Tx
            PduRSrcPdu_f4835c60 (PduRSrcPdu): PduRSrcPduRef=EcucPduCollection/msg_diag_Response_MyECU_oCAN00_f4dcbbcd_Tx
