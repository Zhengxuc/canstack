AUTOSAR XML (schema 00044)
package /VehicleProject
  system System
    root-software-compositions:
      root sw composition prototype EcuSwComposition: software-composition=ECU_Composition
package /ECUCompositionTypes
  composition sw component type ECU_Composition
    component CpLedTask: type=CtLedTask
    component Cdd_SBC_UJA1169: type=CddSbc
    component PWLTask: type=PWL
package /EndToEndProtections
  end to end protection set EndToEndProtectionSet
