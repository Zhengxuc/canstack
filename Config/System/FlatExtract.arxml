AUTOSAR XML (schema 00044)
package /COM/VECTOR/CFG/WORKFLOW/SYSDESC/SYNC
  system SYSTEM: category=ECU_EXTRACT
    system mapping MAPPINGS
      data-mappings:
        data-element=CpLedTask.COMPOSITIONTYPE.LampCnt.u8_Singal, system-signal=sig_LampCnt
        data-element=CpLedTask.COMPOSITIONTYPE.Bool_Signal.Bool_Signal, system-signal=sig_RearInteriorLight
        data-element=CpLedTask.COMPOSITIONTYPE.RearInterLight.Bool_Signal, system-signal=sig_RearInteriorLight
        data-element=CpLedTask.COMPOSITIONTYPE.FrontInterLight.bool_Signal, system-signal=sig_FrontInterLight
        data-element=CpLedTask.COMPOSITIONTYPE.RearLedftWindow_Position.u8_Signal, system-signal=sig_RearLeftWindow_Position
        data-element=CpLedTask.COMPOSITIONTYPE.RearRightWindow_Position.u8_Signal, system-signal=sig_RearRightWindow_Position
    root-software-compositions:
      root sw composition prototype COMPOSITIONTYPE: flat-map=FLATMAP, software-composition=COMPOSITIONTYPE
  composition sw component type COMPOSITIONTYPE  # UB:Derived from original system description
    10 x component:
      BswM: type=BswM
      ComM: type=ComM
      Det: type=Det
      EcuM: type=EcuM
      Os_OsCore0_swc: type=Os_OsCore0_swc
      DemMaster_0: type=DemMaster_0
      DemSatellite_0: type=DemSatellite_0
      Dcm: type=Dcm
      CpLedTask: type=CtLedTask
      Cdd_SBC_UJA1169: type=CddSbc
    connect BswM.Switch_ESH_ModeSwitch -> BswM.Notification_ESH_ModeNotification
    connect ComM.UR_CN_CAN00_06ecbb07 -> CpLedTask.UR_CN_CAN00_06ecbb07
  end to end protection set E2EPROTECTIONSET
  port interface mapping set PORTINTERFACEMAPPINGSET
