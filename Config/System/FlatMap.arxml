AUTOSAR XML (schema 4-2-1)
package /COM/VECTOR/CFG/WORKFLOW/SYSDESC/SYNC
  flat map FLATMAP
    flat instance descriptor CpLedTask: upstream-reference=EcuSwComposition.CpLedTask, ecu-extract-reference=COMPOSITIONTYPE.CpLedTask
    flat instance descriptor Cdd_SBC_UJA1169: upstream-reference=EcuSwComposition.Cdd_SBC_UJA1169, ecu-extract-reference=COMPOSITIONTYPE.Cdd_SBC_UJA1169
    flat instance descriptor PWLTask: upstream-reference=EcuSwComposition.PWLTask, ecu-extract-reference=COMPOSITIONTYPE.PWLTask
